## src/drivers/optical_flow/flow3953/Kconfig
```kconfig
menuconfig DRIVERS_OPTICAL_FLOW_FLOW3953
	bool "flow3953"
	default n
	---help---
		Enable support for flow3953
```

## src/drivers/smart_battery/ip5109/Kconfig
```kconfig
menuconfig DRIVERS_SMART_BATTERY_IP5109
	bool "batmon"
	default n
	---help---
		Enable support for battery chip IP5109
```

## src/examples/esp_sbus_inv_ctrl/Kconfig
```kconfig
menuconfig EXAMPLES_ESP_SBUS_INV_CTRL
	bool "ESP_SBUS_INV_CTRL"
	default n
	---help---
		Enable support for esp32s3 sbus inverter ctrl
```
