PROVIDE( cache_get_dcache_line_size = Cache_Get_DCache_Line_Size );
PROVIDE( cache_get_icache_line_size = Cache_Get_ICache_Line_Size );
PROVIDE( cache_dbus_mmu_set = Cache_Dbus_MMU_Set );
PROVIDE( cache_ibus_mmu_set = Cache_Ibus_MMU_Set );
PROVIDE( cache_clean_addr = Cache_Clean_Addr );
PROVIDE( cache_invalidate_addr = Cache_Invalidate_Addr );
PROVIDE( cache_invalidate_dcache_all = Cache_Invalidate_DCache_All );
PROVIDE( cache_invalidate_icache_all = Cache_Invalidate_ICache_All );
PROVIDE( cache_invalidate_icache_items = Cache_Invalidate_ICache_Items );
PROVIDE( cache_invalidate_dcache_items = Cache_Invalidate_DCache_Items );
PROVIDE( cache_lock_icache_items = Cache_Lock_ICache_Items );
PROVIDE( cache_lock_dcache_items = Cache_Lock_DCache_Items );
PROVIDE( cache_unlock_icache_items = Cache_Unlock_ICache_Items );
PROVIDE( cache_unlock_dcache_items = Cache_Unlock_DCache_Items );
PROVIDE( cache_occupy_addr = Cache_Occupy_Addr );
PROVIDE( cache_resume_dcache = Cache_Resume_DCache );
PROVIDE( cache_resume_icache = Cache_Resume_ICache );
PROVIDE( cache_set_idrom_mmu_info = Cache_Set_IDROM_MMU_Info );
PROVIDE( cache_set_idrom_mmu_size = Cache_Set_IDROM_MMU_Size );
PROVIDE( cache_suspend_dcache = Cache_Suspend_DCache );
PROVIDE( cache_suspend_icache = Cache_Suspend_ICache );
PROVIDE( cache_writeback_all = Cache_WriteBack_All );
PROVIDE( cache_writeback_items = Cache_WriteBack_Items );
PROVIDE( cache_writeback_addr = Cache_WriteBack_Addr );
